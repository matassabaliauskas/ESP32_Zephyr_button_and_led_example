## zephyr/app/sample.yaml
```yaml
sample:
  description: MQTT Test project for BACE
  name: mqtt_test
common:
  tags: introduction
  integration_platforms:
    - native_sim
  harness: console
  harness_config:
    type: one_line
    regex:
      - "Hello World! (.*)"
tests:
  sample.basic.helloworld:
    tags: introduction
```
